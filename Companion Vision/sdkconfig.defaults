## Companion Vision/sdkconfig.defaults
```kconfig
# Supported targets for this project
CONFIG_IDF_TARGET="esp32s3"

# ESP32S3 Board Configuration for Smart Glasses OCR
CONFIG_IDF_TARGET_ESP32S3=y
CONFIG_ESP_DEFAULT_CPU_FREQ_MHZ_240=y
CONFIG_ESP32S3_DEFAULT_CPU_FREQ_240=y

# Custom partition table for larger app size with Bluetooth
CONFIG_PARTITION_TABLE_CUSTOM=y
CONFIG_PARTITION_TABLE_CUSTOM_FILENAME="partitions.csv"

# Camera Configuration for OV2640
CONFIG_CAMERA_MODEL_ESP_EYE=y

# Memory Configuration (no PSRAM for XIAO ESP32S3 Sense)
CONFIG_ESP32S3_SPIRAM_SUPPORT=n

# Bluetooth Configuration for BLE only (ESP32-S3 limitation)
# ESP32-S3 does not support Classic Bluetooth, only Bluetooth LE
CONFIG_BT_ENABLED=y
CONFIG_BT_CONTROLLER_ENABLED=y
CONFIG_BT_BLUEDROID_ENABLED=y
CONFIG_BT_BLE_ENABLED=y
# CONFIG_BT_CLASSIC_ENABLED is not available on ESP32-S3
# CONFIG_BT_A2DP_ENABLE is not available on ESP32-S3
# CONFIG_BT_SPP_ENABLED is not available on ESP32-S3

# Flash size configuration
CONFIG_ESPTOOLPY_FLASHSIZE_4MB=y

# FreeRTOS configuration for dual-core operation
CONFIG_FREERTOS_UNICORE=n

# Memory Configuration - Disable PSRAM for now to get basic system working
# PSRAM may need specific configuration for XIAO ESP32S3 Sense
# CONFIG_SPIRAM is not set

# SD Card Configuration
CONFIG_FATFS_LONG_FILENAMES=y
CONFIG_FATFS_LFN_HEAP=y

# Camera Configuration - Updated for ESP-IDF v6.0
CONFIG_OV2640_SUPPORT=y

# Audio Configuration - Removed deprecated I2S option

# Logging Level
CONFIG_LOG_DEFAULT_LEVEL_INFO=y
CONFIG_LOG_MAXIMUM_LEVEL_VERBOSE=y
```
